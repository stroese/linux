## at91sam9g25-gardena-smart-gateway.its
```
/*
 * Simple U-Boot uImage source file containing a single kernel and FDT blob
 */

/dts-v1/;

/ {
	description = "Gardena smart Gateway AT91SAM image with single Linux kernel and FDT blob";
	#address-cells = <1>;

	images {
		kernel@1 {
			description = "Linux kernel";
			data = /incbin/("./arch/arm/boot/zImage");
			type = "kernel";
			arch = "arm";
			os = "linux";
			compression = "none";
			load =  <0x20008000>;
			entry = <0x20008000>;
			hash@1 {
				algo = "sha1";
			};
		};

		fdt@1 {
			description = "Flattened Device Tree blob";
			data = /incbin/("./arch/arm/boot/dts/at91sam9g25-gardena-smart-gateway.dtb");
			type = "flat_dt";
			arch = "arm";
			compression = "none";
			hash@1 {
				algo = "sha1";
			};
		};
	};

	configurations {
		default = "conf@1";
		conf@1 {
			description = "Boot Linux kernel with FDT blob";
			kernel = "kernel@1";
			fdt = "fdt@1";
		};
	};
};
```

## gardena_smart_gateway_mt7688.its
```
/*
 * Simple U-boot uImage source file containing a single kernel and FDT blob
 */

/dts-v1/;

/ {
	description = "Gardena smart-gateway MT7688 image with single Linux kernel and FDT blob";
	#address-cells = <1>;

	images {
		kernel@1 {
			description = "Linux kernel";
			data = /incbin/("./arch/mips/boot/vmlinux.bin");
			type = "kernel";
			arch = "mips";
			os = "linux";
			compression = "none";
			load =  <0x80000000>;
			entry = <0x80000400>;
			hash@1 {
				algo = "sha1";
			};
		};

		fdt@1 {
			description = "Flattened Device Tree blob";
			data = /incbin/("./arch/mips/boot/dts/ralink/gardena_smart_gateway_mt7688.dtb");
			type = "flat_dt";
			arch = "mips";
			compression = "none";
			hash@1 {
				algo = "sha1";
			};
		};
	};

	configurations {
		default = "conf@1";
		conf@1 {
			description = "Boot Linux kernel with FDT blob";
			kernel = "kernel@1";
			fdt = "fdt@1";
		};
	};
};
```
